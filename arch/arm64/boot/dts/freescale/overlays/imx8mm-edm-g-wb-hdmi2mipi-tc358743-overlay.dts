// SPDX-License-Identifier: (GPL-2.0+ OR MIT)
/*
 * Copyright 2020 TechNexion Ltd.
 *
 * Author: Richard Hu <richard.hu@technexion.com>
 *         Ray Chang <ray.chang@technexion.com>
 *
 */

/dts-v1/;
/plugin/;

#include <dt-bindings/interrupt-controller/irq.h>
#include <dt-bindings/clock/imx8mm-clock.h>
#include <dt-bindings/gpio/gpio.h>

/ {

	fragment@1 {
		/* AUD_B */
		target = <&sai5>;
		__overlay__ {
			status = "okay";
		};
	};

	fragment@2 {
		target = <&csi1_bridge>;
		__overlay__ {
			status = "okay";
		};
	};



};
